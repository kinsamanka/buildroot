## board/cvitek/milkv-duo/multi.its
```
/dts-v1/;
/ {
	description = "Milk-V Duo SD";
	images {
		kernel-1 {
			data = /incbin/("./Image.lzma");
			type = "kernel";
			arch = "riscv";
			os = "linux";
			compression = "lzma";
			load = <0x0 0x80200000>;
			entry = <0x0 0x80200000>;
			hash-2 {
				algo = "crc32";
			};
		};
		fdt-1 {
			data = /incbin/("./cv1800b_milkv_duo_sd.dtb");
			type = "flat_dt";
			arch = "riscv";
			compression = "none";
			hash-1 {
				algo = "sha256";
			};
		};
	};
	configurations {
		config-cv1800b_milkv_duo_sd {
			kernel = "kernel-1";
			fdt = "fdt-1";
		};
	};
};
```

## configs/milkv_duo_defconfig
```kconfig
BR2_riscv=y
BR2_riscv_custom=y
BR2_RISCV_ISA_CUSTOM_RVM=y
BR2_RISCV_ISA_CUSTOM_RVA=y
BR2_RISCV_ISA_CUSTOM_RVF=y
BR2_RISCV_ISA_CUSTOM_RVD=y
BR2_RISCV_ISA_CUSTOM_RVC=y
BR2_RISCV_ISA_CUSTOM_RVV=y
BR2_TOOLCHAIN_BUILDROOT_MUSL=y
BR2_KERNEL_HEADERS_5_10=y
BR2_BINUTILS_VERSION_RISCV=y
BR2_GLOBAL_PATCH_DIR="board/cvitek/milkv-duo/patches"
BR2_SYSTEM_DHCP="eth0"
BR2_ROOTFS_POST_IMAGE_SCRIPT="board/cvitek/milkv-duo/post-image.sh"
BR2_LINUX_KERNEL=y
BR2_LINUX_KERNEL_CUSTOM_GIT=y
BR2_LINUX_KERNEL_CUSTOM_REPO_URL=" https://github.com/kinsamanka/milkv-linux.git"
BR2_LINUX_KERNEL_CUSTOM_REPO_VERSION="cvitek"
BR2_LINUX_KERNEL_DEFCONFIG="cv1800b_milkv_duo_sd"
BR2_LINUX_KERNEL_LZMA=y
BR2_PACKAGE_BUSYBOX_CONFIG="board/cvitek/busybox.config"
BR2_PACKAGE_DROPBEAR=y
BR2_TARGET_ROOTFS_EXT2=y
BR2_TARGET_ROOTFS_EXT2_4=y
# BR2_TARGET_ROOTFS_TAR is not set
BR2_TARGET_OPENSBI=y
BR2_TARGET_OPENSBI_CUSTOM_GIT=y
BR2_TARGET_OPENSBI_CUSTOM_REPO_URL="https://github.com/kinsamanka/milkv-opensbi.git"
BR2_TARGET_OPENSBI_CUSTOM_REPO_VERSION="cvitek"
BR2_TARGET_OPENSBI_PLAT="generic"
# BR2_TARGET_OPENSBI_INSTALL_JUMP_IMG is not set
BR2_TARGET_OPENSBI_UBOOT_PAYLOAD=y
BR2_TARGET_OPENSBI_ADDITIONAL_VARIABLES="FW_FDT_PATH=$(BUILD_DIR)/uboot-cvitek/arch/riscv/dts/cv1800b_milkv_duo_sd.dtb"
BR2_TARGET_UBOOT=y
BR2_TARGET_UBOOT_BUILD_SYSTEM_KCONFIG=y
BR2_TARGET_UBOOT_CUSTOM_GIT=y
BR2_TARGET_UBOOT_CUSTOM_REPO_URL="https://github.com/kinsamanka/milkv-u-boot"
BR2_TARGET_UBOOT_CUSTOM_REPO_VERSION="cvitek"
BR2_TARGET_UBOOT_BOARD_DEFCONFIG="cv1800b-milkv-duo-sd"
BR2_TARGET_UBOOT_NEEDS_DTC=y
BR2_TARGET_UBOOT_FORMAT_DTB=y
BR2_TARGET_UBOOT_CUSTOM_DTS_PATH="$(TOPDIR)/board/cvitek/common/dts/* $(TOPDIR)/board/cvitek/milkv-duo/dts/*"
BR2_TARGET_UBOOT_CUSTOM_MAKEOPTS="CONFIG_SKIP_RAMDISK=y CONFIG_USE_DEFAULT_ENV=y CVIBOARD=milkv_duo_sd CHIP=cv1800b STORAGE_TYPE=sd"
BR2_PACKAGE_HOST_GENIMAGE=y
BR2_PACKAGE_HOST_MTOOLS=y
BR2_PACKAGE_HOST_UBOOT_TOOLS=y
BR2_PACKAGE_HOST_UBOOT_TOOLS_FIT_SUPPORT=y
```

## configs/milkv_duo_external_toolchain_defconfig
```kconfig
BR2_riscv=y
BR2_riscv_custom=y
BR2_RISCV_ISA_CUSTOM_RVM=y
BR2_RISCV_ISA_CUSTOM_RVA=y
BR2_RISCV_ISA_CUSTOM_RVF=y
BR2_RISCV_ISA_CUSTOM_RVD=y
BR2_RISCV_ISA_CUSTOM_RVC=y
BR2_RISCV_ISA_CUSTOM_RVV=y
BR2_TOOLCHAIN_EXTERNAL=y
BR2_TOOLCHAIN_EXTERNAL_DOWNLOAD=y
BR2_TOOLCHAIN_EXTERNAL_URL="file://$(TOPDIR)/riscv64-buildroot-linux-musl_sdk-buildroot.tar.gz"
BR2_TOOLCHAIN_EXTERNAL_GCC_9=y
BR2_TOOLCHAIN_EXTERNAL_HEADERS_5_10=y
BR2_TOOLCHAIN_EXTERNAL_CUSTOM_MUSL=y
BR2_GLOBAL_PATCH_DIR="$(TOPDIR)/board/cvitek/common/patches"
BR2_SYSTEM_DHCP="eth0"
BR2_ROOTFS_OVERLAY="board/cvitek/milkv-duo/rootfs_overlay"
BR2_ROOTFS_POST_IMAGE_SCRIPT="board/cvitek/milkv-duo/post-image.sh"
BR2_LINUX_KERNEL=y
BR2_LINUX_KERNEL_CUSTOM_GIT=y
BR2_LINUX_KERNEL_CUSTOM_REPO_URL="https://github.com/T-head-Semi/linux.git"
BR2_LINUX_KERNEL_CUSTOM_REPO_VERSION="b1313fe517ca3703119dcc99ef3bbf75ab42bcfb"
BR2_LINUX_KERNEL_DEFCONFIG="cv1800b_milkv_duo_sd"
BR2_LINUX_KERNEL_LZMA=y
BR2_PACKAGE_BUSYBOX_CONFIG="board/cvitek/common/busybox.config"
BR2_PACKAGE_DROPBEAR=y
BR2_TARGET_ROOTFS_EXT2=y
BR2_TARGET_ROOTFS_EXT2_4=y
# BR2_TARGET_ROOTFS_TAR is not set
BR2_TARGET_OPENSBI=y
BR2_TARGET_OPENSBI_CUSTOM_GIT=y
BR2_TARGET_OPENSBI_CUSTOM_REPO_URL="https://github.com/T-head-Semi/opensbi.git"
BR2_TARGET_OPENSBI_CUSTOM_REPO_VERSION="89182b257c8798e15e4c685c1af0c2862d528d2a"
BR2_TARGET_OPENSBI_PLAT="generic"
# BR2_TARGET_OPENSBI_INSTALL_JUMP_IMG is not set
BR2_TARGET_OPENSBI_UBOOT_PAYLOAD=y
BR2_TARGET_OPENSBI_ADDITIONAL_VARIABLES="FW_FDT_PATH=$(BUILD_DIR)/uboot-d80bb749fab53da72c4a0e09b8c2d2aaa3103c91/arch/riscv/dts/cv1800b_milkv_duo_sd.dtb"
BR2_TARGET_UBOOT=y
BR2_TARGET_UBOOT_BUILD_SYSTEM_KCONFIG=y
BR2_TARGET_UBOOT_CUSTOM_GIT=y
BR2_TARGET_UBOOT_CUSTOM_REPO_URL="https://github.com/u-boot/u-boot.git"
BR2_TARGET_UBOOT_CUSTOM_REPO_VERSION="d80bb749fab53da72c4a0e09b8c2d2aaa3103c91"
BR2_TARGET_UBOOT_BOARD_DEFCONFIG="cv1800b-milkv-duo-sd"
BR2_TARGET_UBOOT_NEEDS_DTC=y
BR2_TARGET_UBOOT_FORMAT_DTB=y
BR2_TARGET_UBOOT_CUSTOM_DTS_PATH="$(TOPDIR)/board/cvitek/common/dts/* $(TOPDIR)/board/cvitek/milkv-duo/dts/*"
BR2_TARGET_UBOOT_CUSTOM_MAKEOPTS="CONFIG_SKIP_RAMDISK=y CONFIG_USE_DEFAULT_ENV=y CVIBOARD=milkv_duo_sd CHIP=cv1800b STORAGE_TYPE=sd"
BR2_PACKAGE_HOST_DOSFSTOOLS=y
BR2_PACKAGE_HOST_GENIMAGE=y
BR2_PACKAGE_HOST_MTOOLS=y
BR2_PACKAGE_HOST_UBOOT_TOOLS=y
BR2_PACKAGE_HOST_UBOOT_TOOLS_FIT_SUPPORT=y
```

## configs/milkv_duo_toolchain_defconfig
```kconfig
BR2_riscv=y
BR2_riscv_custom=y
BR2_RISCV_ISA_CUSTOM_RVM=y
BR2_RISCV_ISA_CUSTOM_RVA=y
BR2_RISCV_ISA_CUSTOM_RVF=y
BR2_RISCV_ISA_CUSTOM_RVD=y
BR2_RISCV_ISA_CUSTOM_RVC=y
BR2_TOOLCHAIN_BUILDROOT_MUSL=y
BR2_KERNEL_HEADERS_5_10=y
BR2_BINUTILS_VERSION_2_41_X=y
BR2_INIT_NONE=y
BR2_SYSTEM_BIN_SH_NONE=y
# BR2_PACKAGE_BUSYBOX is not set
# BR2_PACKAGE_IFUPDOWN_SCRIPTS is not set
# BR2_TARGET_ROOTFS_TAR is not set
```
